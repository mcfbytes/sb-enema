## sb_enema/Config.in
```kconfig
menu "SB-ENEMA external options"

source "$BR2_EXTERNAL_SB_ENEMA_PATH/package/efitools/Config.in"
source "$BR2_EXTERNAL_SB_ENEMA_PATH/package/sbsigntools/Config.in"

endmenu
```

## sb_enema/configs/sb_enema_defconfig
```kconfig
# Buildroot configuration for the SB-ENEMA secure boot reprovisioning environment.

# See also https://github.com/batocera-linux/batocera.linux/blob/master/configs/batocera-x86_64.board
# for an example configuration targeting x86_64 hardware.

# https://gitlab.com/buildroot.org/buildroot/-/blob/2025.11.2/Config.in?ref_type=tags

BR2_x86_64=y
BR2_TOOLCHAIN_BUILDROOT_GLIBC=y
BR2_GLOBAL_PATCH_DIR="../../sb_enema/patches"
BR2_ROOTFS_OVERLAY="../../sb_enema/board/sb-enema/rootfs-overlay"
BR2_TARGET_GENERIC_HOSTNAME="sb-enema"
BR2_TARGET_GENERIC_ISSUE="SB-ENEMA secure boot reprovisioning environment"
BR2_INIT_BUSYBOX=y
BR2_PACKAGE_BUSYBOX_CONFIG_FRAGMENT_FILES="../../sb_enema/board/sb-enema/busybox-fragment.config"

# /dev management — use devtmpfs + mdev for initramfs/CPIO boot
BR2_ROOTFS_DEVICE_CREATION_DYNAMIC_MDEV=y

# Secure boot tooling
BR2_PACKAGE_OPENSSL=y
BR2_PACKAGE_LIBOPENSSL_BIN=y
BR2_PACKAGE_UTIL_LINUX=y
BR2_PACKAGE_UTIL_LINUX_AGETTY=y
BR2_PACKAGE_UTIL_LINUX_LIBUUID=y
BR2_PACKAGE_GNU_EFI=y
BR2_PACKAGE_EFITOOLS=y
BR2_PACKAGE_SBSIGNTOOLS=y
BR2_PACKAGE_JQ=y
BR2_PACKAGE_DIALOG=y

# Kernel configuration
BR2_LINUX_KERNEL=y
BR2_LINUX_KERNEL_USE_DEFCONFIG=y
BR2_LINUX_KERNEL_DEFCONFIG="x86_64"
BR2_LINUX_KERNEL_CONFIG_FRAGMENT_FILES="../../sb_enema/board/sb-enema/kernel-fragment.config"

# Host tooling required for image creation
BR2_PACKAGE_HOST_GENIMAGE=y
BR2_PACKAGE_HOST_DOSFSTOOLS=y
BR2_PACKAGE_HOST_MTOOLS=y

# Root filesystem
BR2_TARGET_ROOTFS_CPIO=y
BR2_TARGET_ROOTFS_CPIO_GZIP=y
BR2_ROOTFS_POST_BUILD_SCRIPT="../../sb_enema/board/sb-enema/post-build.sh"
BR2_ROOTFS_POST_IMAGE_SCRIPT="../../sb_enema/board/sb-enema/post-image.sh"

# Shell
BR2_PACKAGE_BUSYBOX_SHOW_OTHERS=y
BR2_PACKAGE_BASH=y

# Auto-login
BR2_TARGET_GENERIC_GETTY=y
# Need a valid baud_rate parameter for agetty, although it is not actually used for VTs
BR2_TARGET_GENERIC_GETTY_BAUDRATE_115200=y
BR2_TARGET_GENERIC_GETTY_OPTIONS="--autologin root"
```

## sb_enema/package/efitools/Config.in
```kconfig
config BR2_PACKAGE_EFITOOLS
	bool "efitools"
	depends on BR2_PACKAGE_OPENSSL
	depends on BR2_PACKAGE_GNU_EFI
	help
	  UEFI secure boot tooling (efi-updatevar, efi-readvar,
	  cert-to-efi-sig-list, sign-efi-sig-list, hash-to-efi-sig-list).

	  https://git.kernel.org/pub/scm/linux/kernel/git/jejb/efitools.git
```

## sb_enema/package/sbsigntools/Config.in
```kconfig
config BR2_PACKAGE_SBSIGNTOOLS
	bool "sbsigntools"
	depends on BR2_PACKAGE_OPENSSL
	select BR2_PACKAGE_UTIL_LINUX_LIBUUID
	help
	  Utilities for signing and verifying files for UEFI Secure Boot
	  (sbsign, sbverify, sbattach, sbdetach).

	  https://git.kernel.org/cgit/linux/kernel/git/jejb/sbsigntools.git/
```
